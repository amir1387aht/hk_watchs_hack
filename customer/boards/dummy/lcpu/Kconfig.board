## customer/boards/ec-lb587_a2/acpu/Kconfig.board
```kconfig
config BSP_USING_BOARD_EC_LB587_A2
    bool
    select SOC_SF32LB58X
    select BF0_ACPU
    select BF0_HCPU
    default y

rsource "../Kconfig.board"
```

## customer/boards/ec-lb587_a2/lcpu/Kconfig.board
```kconfig
config BSP_USING_BOARD_EC_LB587_A2
    bool
    select SOC_SF32LB58X
    select BF0_LCPU
    default y

rsource "../Kconfig.board"
```

## customer/boards/eh-lb523_dual/lcpu/Kconfig.board
```kconfig
config BSP_USING_BOARD_EH_LB523_DUAL
    bool
    select SOC_SF32LB52X
    select BF0_LCPU
    default y

rsource "../Kconfig.board"
```

## customer/boards/pc/lcpu/Kconfig.board
```kconfig
config BSP_USING_PC_SIMULATOR
    bool
    select SOC_SIMULATOR
    default y

rsource "../Kconfig.board"
```

## customer/boards/sf32-oed-epd/hcpu/Kconfig.board
```kconfig
config BSP_USING_BOARD_SF32_OED_EPD
    bool
    select SOC_SF32LB52X
    select BF0_HCPU
    default y

rsource "../Kconfig.board"
```

## customer/boards/sf32-oed-epd/lcpu/Kconfig.board
```kconfig
config BSP_USING_BOARD_EM_LB525_EPD
    bool
    select SOC_SF32LB52X
    select BF0_LCPU
    default y

rsource "../Kconfig.board"
```

## customer/boards/sf32lb52-core_52j_n16/lcpu/Kconfig.board
```kconfig
config BSP_USING_BOARD_SF32LB52_CORE_52J_N16
    bool
    select SOC_SF32LB52X
    select BF0_LCPU
    default y

rsource "../Kconfig.board"
```

## customer/boards/sf32lb52-lcd_52d/hcpu/Kconfig.board
```kconfig
config BSP_USING_BOARD_SF32LB52_LCD_52D
    bool
    select SOC_SF32LB52X
    select BF0_HCPU
    default y

rsource "../Kconfig.board"
```

## customer/boards/sf32lb52-lcd_n16r8/lcpu/Kconfig.board
```kconfig
config BSP_USING_BOARD_SF32LB52_LCD_N16R8
    bool
    select SOC_SF32LB52X
    select BF0_LCPU
    default y

rsource "../Kconfig.board"
```

## customer/boards/sf32lb56-lcd_a128r12n1/lcpu/Kconfig.board
```kconfig
config BSP_USING_BOARD_SF32LB56_LCD_A128R12N1
    bool
    select SOC_SF32LB56X
    select BF0_LCPU
    default y

rsource "../Kconfig.board"
```

## customer/boards/sf32lb56-lcd_n16r12n1/lcpu/Kconfig.board
```kconfig
config BSP_USING_BOARD_SF32LB56_LCD_N16R12N1
    bool
    select SOC_SF32LB56X
    select BF0_LCPU
    default y

rsource "../Kconfig.board"
```

## customer/boards/sf32lb58-lcd_n16r64n4/hcpu/Kconfig.board
```kconfig
config BSP_USING_BOARD_SF32LB58_LCD_N16R64N4
    bool
    select SOC_SF32LB58X
    select BF0_HCPU
    default y

rsource "../Kconfig.board"
```

## customer/peripherals/pa/Kconfig
```kconfig
menu "Power Amplifier"

config PA_USING_AW882XX
    bool  "digital PA AW882XX enable"
    default n
config PA_USING_AW87390
    bool  "analog PA AW87390 enable"
    default n
    if PA_USING_AW87390
        config AW87390_GPIO_PIN
            int "AW87390 Control PIN"
            default 0
    endif 
config PA_USING_AW8155
    bool  "analog PA AW8155 enable"
    default n
    if PA_USING_AW8155
        config AW8155_GPIO_PIN
            int "AW8155 Control PIN"
            default 0
    endif 

endmenu
```

## customer/peripherals/rgb/Kconfig
```kconfig
menuconfig RGB_SK6812MINI_HS_ENABLE
    bool "Enable rgbled"
    default n
    if RGB_SK6812MINI_HS_ENABLE
        config RGB_USING_SK6812MINI_HS_DEV_NAME
            bool "Enable_RGB_SK6812MINI-HS"
            default n
        config RGB_USING_SK6812MINI_HS_PWM_DEV_NAME
            string "pwm device name"
            default "pwm4"
        depends on RGB_USING_SK6812MINI_HS_DEV_NAME
        config BSP_USING_RGBLED_CH
            int "Channel"
            default "4"
        depends on RGB_USING_SK6812MINI_HS_DEV_NAME
    endif
```

## example/bt/3sco/project/Kconfig.proj
```kconfig
#APP specific configuration.
config BF0_HCPU
    bool
    default y

config CUSTOM_MEM_MAP
    bool 
	select custom_mem_map
	default y    

config SF32LB58X_3SCO
	bool
		default y
```

## example/lcd_fb/project/Kconfig.proj
```kconfig
#APP specific configuration.
config CUSTOM_MEM_MAP
    bool 
	select custom_mem_map
	default y
	

select BSP_USING_LCD_FRAMEBUFFER
```

## example/zbt/broadcaster/project/Kconfig.proj
```kconfig
#APP specific configuration.
config CUSTOM_MEM_MAP
    bool 
	select custom_mem_map
	default y    

config ISO_PRINT_INTERVAL
	int "Interval between each packet report"
	range 1 360000
	default 100
	help
	  Only print the packet report once in a given interval of ISO packets.
```

## example/zbt/central_multilink/project/Kconfig.proj
```kconfig
#APP specific configuration.
config CUSTOM_MEM_MAP
    bool 
	select custom_mem_map
	default y    

config SAMPLE_CONN_ITERATIONS
	int "Connection iterations"
	range 0 255
	default 1
	help
	  Number of times to connect and disconnect to peripheral_identity
	  sample.
      
```

## example/zbt/iso_receive/project/Kconfig.proj
```kconfig
#APP specific configuration.
config CUSTOM_MEM_MAP
    bool 
	select custom_mem_map
	default y    

config ISO_PRINT_INTERVAL
	int "Interval between each packet report"
	range 1 360000
	default 1
	help
	  Only print the packet report once in a given interval of ISO packets.

config ISO_ALIGN_PRINT_INTERVALS
	bool "Align report interval with incoming packets"
	help
	  Align interval-counter with packet number from incoming ISO packets.
	  This may be needed if report printouts are to be synchronized between
	  the iso_broadcast sample and the iso_receive sample.
```

## example/zbt/mesh_onoff-app/project/Kconfig.proj
```kconfig
#APP specific configuration.
config CUSTOM_MEM_MAP
    bool 
	select custom_mem_map
	default y    

config NODE_ADDR
    int "Node address" 
	default 12   
      
```

## example/zbt/periodic_sync/project/Kconfig.proj
```kconfig
#APP specific configuration.
config CUSTOM_MEM_MAP
    bool 
	select custom_mem_map
	default y    

config PER_ADV_NAME
	string "Target Periodic Advertising Name"
	default ""
	help
	  Name of target advertising for Periodic Advertising Synchronization.
      
```
