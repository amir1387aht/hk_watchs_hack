## external/ffmpeg/Kconfig
```kconfig
menuconfig PKG_USING_FFMPEG
    bool "Enable FFMPEG"
    default n
config PKG_USING_FFMPEG_AUDIO
    bool "Enable ffpmeg audio support"
        depends on PKG_USING_FFMPEG
    default y
config PKG_USING_FFMPEG_MJPEG
    bool "Enable ffpmeg MotionJpeg(mjpeg) support"
        depends on PKG_USING_FFMPEG
    default n
config PKG_USING_FFMPEG_HTTP
    bool "Enable ffpmeg http"
        depends on PKG_USING_FFMPEG
    default n
```

## external/jpeg_nano/Kconfig
```kconfig
config USING_JPEG_NANOENC
    bool "Enable Nano JPEG Encoder"
    default n
config USING_JPEG_NANODEC
    bool "Enable Nano Jpeg Decoder"
    default n
```

## external/vglite/Kconfig
```kconfig
menuconfig USING_VGLITE
    bool "Enable VG-Lite"
    default n
    
    if USING_VGLITE
        config USING_VGLITE_STATIC_CONT_MEM
            bool "Use static contiguous mem for VG-Lite"
            default n
        config VGLITE_CONT_MEM_SIZE
            int "VG-Lite contiguous mem size in kbyte"
            default 256
    endif     
```
